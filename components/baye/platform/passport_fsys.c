#include "passport_fsys.h"
#include <stdio.h>
#include <stdlib.h>
#include <string.h>

#ifdef ESP_PLATFORM
#include "esp_log.h"
#include "nvs_flash.h"
#include "nvs.h"
static const char *TAG = "baye_fsys";
#else
#define ESP_LOGI(tag, fmt, ...) printf("[%s] " fmt "\n", tag, ##__VA_ARGS__)
#define ESP_LOGW(tag, fmt, ...) printf("[%s] WARN: " fmt "\n", tag, ##__VA_ARGS__)
#define ESP_LOGE(tag, fmt, ...) printf("[%s] ERROR: " fmt "\n", tag, ##__VA_ARGS__)
static const char *TAG = "baye_fsys";
#endif

// Symbols generated by target_add_binary_data in ESP-IDF
#ifdef ESP_PLATFORM
extern const uint8_t _binary_dat_lib_start[] asm("_binary_dat_lib_start");
extern const uint8_t _binary_dat_lib_end[]   asm("_binary_dat_lib_end");
extern const uint8_t _binary_font_bin_start[] asm("_binary_font_bin_start");
extern const uint8_t _binary_font_bin_end[]   asm("_binary_font_bin_end");
#endif

static const uint8_t *s_dat_lib_ptr = NULL;
static size_t s_dat_lib_len = 0;
static const uint8_t *s_font_bin_ptr = NULL;
static size_t s_font_bin_len = 0;

#ifdef ESP_PLATFORM
static nvs_handle_t s_nvs_save = 0;
static bool s_nvs_ready = false;
#else
// Host mock for save files
static uint8_t s_host_save_ram[6][PASSPORT_MAX_SAVE_SIZE];
static size_t s_host_save_lens[6] = {0};
#endif

void passport_fsys_set_rom_assets(const uint8_t *dat_lib, size_t dat_lib_len,
                                 const uint8_t *font_bin, size_t font_bin_len) {
    s_dat_lib_ptr = dat_lib;
    s_dat_lib_len = dat_lib_len;
    s_font_bin_ptr = font_bin;
    s_font_bin_len = font_bin_len;
}

void passport_fsys_init(void) {
#ifdef ESP_PLATFORM
    if (s_dat_lib_ptr == NULL) {
        s_dat_lib_ptr = _binary_dat_lib_start;
        s_dat_lib_len = _binary_dat_lib_end - _binary_dat_lib_start;
    }
    if (s_font_bin_ptr == NULL) {
        s_font_bin_ptr = _binary_font_bin_start;
        s_font_bin_len = _binary_font_bin_end - _binary_font_bin_start;
    }

    esp_err_t err = nvs_flash_init();
    if (err == ESP_ERR_NVS_NO_FREE_PAGES || err == ESP_ERR_NVS_NEW_VERSION_FOUND) {
        ESP_LOGW(TAG, "NVS partition needs erase, initializing fresh");
        nvs_flash_erase();
        err = nvs_flash_init();
    }
    if (err == ESP_OK) {
        err = nvs_open("baye_sav", NVS_READWRITE, &s_nvs_save);
        if (err == ESP_OK) {
            s_nvs_ready = true;
            ESP_LOGI(TAG, "NVS save storage initialized");
        } else {
            ESP_LOGE(TAG, "Failed to open NVS namespace baye_sav: %s", esp_err_to_name(err));
        }
    } else {
        ESP_LOGE(TAG, "Failed to init NVS: %s", esp_err_to_name(err));
    }
#endif

    ESP_LOGI(TAG, "ROM assets: dat.lib=%u bytes, font.bin=%u bytes",
             (unsigned)s_dat_lib_len, (unsigned)s_font_bin_len);
}

static void extract_key_from_path(const char *path, char *key, size_t max_len) {
    const char *p = strrchr(path, '/');
    if (p) {
        p++;
    } else {
        p = path;
    }
    // E.g. "sango0.sav" -> key "sango0"
    size_t i = 0;
    while (*p && *p != '.' && i < max_len - 1) {
        key[i++] = *p++;
    }
    key[i] = '\0';
}

gam_FILE *gam_fopen(const uint8_t *fname_u8, uint8_t pmode) {
    const char *fname = (const char *)fname_u8;
    if (!fname) return NULL;

    // 1. Check for dat.lib
    if (strstr(fname, "dat.lib") != NULL) {
        if (!s_dat_lib_ptr) passport_fsys_init();
        if (!s_dat_lib_ptr || s_dat_lib_len == 0) {
            ESP_LOGE(TAG, "dat.lib not loaded");
            return NULL;
        }
        gam_FILE *fp = (gam_FILE *)calloc(1, sizeof(gam_FILE));
        if (!fp) return NULL;
        fp->openmode = 'r';
        fp->ro_data = s_dat_lib_ptr;
        fp->flen = s_dat_lib_len;
        strncpy(fp->fname, "dat.lib", sizeof(fp->fname) - 1);
        return fp;
    }

    // 2. Check for font.bin
    if (strstr(fname, "font.bin") != NULL) {
        if (!s_font_bin_ptr) passport_fsys_init();
        if (!s_font_bin_ptr || s_font_bin_len == 0) {
            ESP_LOGE(TAG, "font.bin not loaded");
            return NULL;
        }
        gam_FILE *fp = (gam_FILE *)calloc(1, sizeof(gam_FILE));
        if (!fp) return NULL;
        fp->openmode = 'r';
        fp->ro_data = s_font_bin_ptr;
        fp->flen = s_font_bin_len;
        strncpy(fp->fname, "font.bin", sizeof(fp->fname) - 1);
        return fp;
    }

    // 3. Save files (e.g. sango0.sav ... sango5.sav)
    char key[16];
    extract_key_from_path(fname, key, sizeof(key));

    if (pmode == 'w') {
        gam_FILE *fp = (gam_FILE *)calloc(1, sizeof(gam_FILE));
        if (!fp) return NULL;
        fp->openmode = 'w';
        fp->rw_buf = (uint8_t *)calloc(1, PASSPORT_MAX_SAVE_SIZE);
        if (!fp->rw_buf) {
            free(fp);
            return NULL;
        }
        fp->flen = 0;
        fp->curset = 0;
        fp->is_dirty = true;
        strncpy(fp->fname, key, sizeof(fp->fname) - 1);
        return fp;
    } else if (pmode == 'r') {
#ifdef ESP_PLATFORM
        if (!s_nvs_ready) {
            ESP_LOGE(TAG, "NVS not ready to read %s", key);
            return NULL;
        }
        size_t required_size = 0;
        esp_err_t err = nvs_get_blob(s_nvs_save, key, NULL, &required_size);
        if (err != ESP_OK || required_size == 0 || required_size > PASSPORT_MAX_SAVE_SIZE) {
            ESP_LOGW(TAG, "Save file %s not found in NVS (err=%d, size=%u)", key, err, (unsigned)required_size);
            return NULL;
        }
        uint8_t *buf = (uint8_t *)malloc(required_size);
        if (!buf) return NULL;
        err = nvs_get_blob(s_nvs_save, key, buf, &required_size);
        if (err != ESP_OK) {
            ESP_LOGE(TAG, "Failed reading save blob %s: %s", key, esp_err_to_name(err));
            free(buf);
            return NULL;
        }
        gam_FILE *fp = (gam_FILE *)calloc(1, sizeof(gam_FILE));
        if (!fp) {
            free(buf);
            return NULL;
        }
        fp->openmode = 'r';
        fp->rw_buf = buf;
        fp->flen = required_size;
        fp->curset = 0;
        strncpy(fp->fname, key, sizeof(fp->fname) - 1);
        ESP_LOGI(TAG, "Loaded save file %s (%u bytes) from NVS", key, (unsigned)required_size);
        return fp;
#else
        // Host mock
        int slot = -1;
        if (sscanf(key, "sango%d", &slot) == 1 && slot >= 0 && slot < 6) {
            if (s_host_save_lens[slot] == 0) return NULL;
            gam_FILE *fp = (gam_FILE *)calloc(1, sizeof(gam_FILE));
            fp->openmode = 'r';
            fp->rw_buf = (uint8_t *)malloc(s_host_save_lens[slot]);
            memcpy(fp->rw_buf, s_host_save_ram[slot], s_host_save_lens[slot]);
            fp->flen = s_host_save_lens[slot];
            fp->curset = 0;
            strncpy(fp->fname, key, sizeof(fp->fname) - 1);
            return fp;
        }
        return NULL;
#endif
    }

    return NULL;
}

int gam_fclose(gam_FILE *fp) {
    if (!fp) return 0;

    if (fp->openmode == 'w' && fp->is_dirty && fp->rw_buf) {
#ifdef ESP_PLATFORM
        if (s_nvs_ready) {
            esp_err_t err = nvs_set_blob(s_nvs_save, fp->fname, fp->rw_buf, fp->flen);
            if (err == ESP_OK) {
                nvs_commit(s_nvs_save);
                ESP_LOGI(TAG, "Saved %s (%u bytes) to NVS", fp->fname, (unsigned)fp->flen);
            } else {
                ESP_LOGE(TAG, "Failed saving %s to NVS: %s", fp->fname, esp_err_to_name(err));
            }
        }
#else
        int slot = -1;
        if (sscanf(fp->fname, "sango%d", &slot) == 1 && slot >= 0 && slot < 6) {
            memcpy(s_host_save_ram[slot], fp->rw_buf, fp->flen);
            s_host_save_lens[slot] = fp->flen;
        }
#endif
    }

    if (fp->rw_buf) {
        free(fp->rw_buf);
        fp->rw_buf = NULL;
    }
    free(fp);
    return 0;
}

size_t gam_fread(void *ptr, size_t size, size_t count, gam_FILE *fp) {
    if (!fp || !ptr || size == 0 || count == 0) return 0;

    size_t total_bytes = size * count;
    if (fp->curset >= fp->flen) return 0;

    if (fp->curset + total_bytes > fp->flen) {
        total_bytes = fp->flen - fp->curset;
    }

    const uint8_t *src = fp->ro_data ? fp->ro_data : fp->rw_buf;
    if (!src) return 0;

    memcpy(ptr, src + fp->curset, total_bytes);
    fp->curset += total_bytes;

    return total_bytes / size;
}

size_t gam_fwrite(const void *ptr, size_t size, size_t count, gam_FILE *fp) {
    if (!fp || !ptr || size == 0 || count == 0) return 0;
    if (fp->openmode != 'w' || !fp->rw_buf) return 0;

    size_t total_bytes = size * count;
    if (fp->curset + total_bytes > PASSPORT_MAX_SAVE_SIZE) {
        total_bytes = PASSPORT_MAX_SAVE_SIZE - fp->curset;
    }

    memcpy(fp->rw_buf + fp->curset, ptr, total_bytes);
    fp->curset += total_bytes;
    if (fp->curset > fp->flen) {
        fp->flen = fp->curset;
    }
    fp->is_dirty = true;

    return total_bytes / size;
}

int gam_fseek(gam_FILE *fp, long offset, int whence) {
    if (!fp) return -1;

    long new_pos = 0;
    switch (whence) {
        case SEEK_SET:
            new_pos = offset;
            break;
        case SEEK_CUR:
            new_pos = (long)fp->curset + offset;
            break;
        case SEEK_END:
            new_pos = (long)fp->flen + offset;
            break;
        default:
            return -1;
    }

    if (new_pos < 0) new_pos = 0;
    if ((size_t)new_pos > fp->flen) new_pos = fp->flen;

    fp->curset = (uint32_t)new_pos;
    return 0;
}

uint32_t gam_ftell(gam_FILE *fp) {
    if (!fp) return 0;
    return fp->curset;
}

uint8_t *gam_fload(uint8_t *bptr, uint32_t addr, gam_FILE *fhandle) {
    if (!bptr) return NULL;
    if (fhandle && addr >= fhandle->flen) {
        return NULL;
    }
    return bptr + addr;
}

uint8_t *gam_freadall(gam_FILE *fhandle) {
    if (!fhandle) return NULL;
    if (fhandle->ro_data) {
        return (uint8_t *)fhandle->ro_data;
    }
    return fhandle->rw_buf;
}
